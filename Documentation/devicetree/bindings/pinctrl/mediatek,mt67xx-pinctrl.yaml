## Documentation/devicetree/bindings/pinctrl/mediatek,mt67xx-pinctrl.yaml
```yaml
# SPDX-License-Identifier: (GPL-2.0-only OR BSD-2-Clause)
%YAML 1.2
---
$id: http://devicetree.org/schemas/pinctrl/mediatek,mt67xx-pinctrl.yaml#
$schema: http://devicetree.org/meta-schemas/core.yaml#

title: Mediatek MT67xx Pin Controller

maintainers:
  - Andy Teng <andy.teng@mediatek.com>
  - AngeloGioacchino Del Regno <angelogioacchino.delregno@collabora.com>
  - Sean Wang <sean.wang@kernel.org>
  - Yassine Oudjana <y.oudjana@protonmail.com>

description:
  The MediaTek pin controller on MT67xx SoCs is used to control
  pin functions, pull up/down resistance and drive strength options.

properties:
  compatible:
    oneOf:
      - enum:
          - mediatek,mt6765-pinctrl
          - mediatek,mt6795-pinctrl
          - mediatek,mt6797-pinctrl
      - items:
          - const: mediatek,mt6779-pinctrl
          - const: syscon

  reg:
    description: Physical addresses for GPIO base(s) and EINT registers.

  reg-names: true

  gpio-controller: true

  "#gpio-cells":
    const: 2
    description: |
      Number of cells in GPIO specifier. Since the generic GPIO binding
      is used, the amount of cells must be specified as 2. See the below
      mentioned gpio binding representation for description of particular
      cells.

  gpio-ranges:
    description: GPIO valid number range.
    maxItems: 1

  interrupts:
    description: The interrupt outputs to sysirq.

  interrupt-controller: true

  "#interrupt-cells":
    const: 2

required:
  - compatible
  - reg
  - reg-names
  - gpio-controller
  - "#gpio-cells"

allOf:
  - $ref: "pinctrl.yaml#"
  - if:
      properties:
        compatible:
          contains:
            const: mediatek,mt6765-pinctrl
    then:
      properties:
        reg:
          minItems: 9
          maxItems: 9

        reg-names:
          items:
            - const: iocfg0
            - const: iocfg1
            - const: iocfg2
            - const: iocfg3
            - const: iocfg4
            - const: iocfg5
            - const: iocfg6
            - const: iocfg7
            - const: eint
  - if:
      properties:
        compatible:
          contains:
            const: mediatek,mt6779-pinctrl
    then:
      properties:
        reg:
          minItems: 9
          maxItems: 9

        reg-names:
          items:
            - const: gpio
            - const: iocfg_rm
            - const: iocfg_br
            - const: iocfg_lm
            - const: iocfg_lb
            - const: iocfg_rt
            - const: iocfg_lt
            - const: iocfg_tl
            - const: eint
  - if:
      properties:
        compatible:
          contains:
            const: mediatek,mt6795-pinctrl
    then:
      properties:
        reg:
          minItems: 2

        reg-names:
          items:
            - const: base
            - const: eint
  - if:
      properties:
        compatible:
          contains:
            const: mediatek,mt6797-pinctrl
    then:
      properties:
        reg:
          minItems: 5
          maxItems: 5

        reg-names:
          items:
            - const: gpio
            - const: iocfgl
            - const: iocfgb
            - const: iocfgr
            - const: iocfgt
  - if:
      properties:
        reg-names:
          contains:
            const: eint
    then:
      required:
        - interrupts
        - interrupt-controller
        - "#interrupt-cells"

# PIN CONFIGURATION NODES
patternProperties:
  '-pins$':
    type: object
    additionalProperties: false
    patternProperties:
      '^pins':
        type: object
        additionalProperties: false
        description: |
          A pinctrl node should contain at least one subnode representing the
          pinctrl groups available on the machine. Each subnode will list the
          pins it needs and how they should be configured, with regard to mux
          configuration, pull-ups/downs, drive strength, input enable/disable
          and schmitt input.
          An example of using macro:
          pincontroller {
            /* GPIO0 set as multifunction GPIO0 */
            gpio-pins {
              pins {
                pinmux = <PINMUX_GPIO0__FUNC_GPIO0>;
              };
            };
            /* GPIO45 set as multifunction SDA0 */
            i2c0-pins {
              pins {
                pinmux = <PINMUX_GPIO45__FUNC_SDA0>;
              };
            };
          };
        $ref: "pinmux-node.yaml"

        properties:
          pinmux:
            description: |
              Integer array, represents gpio pin number and mux setting.
              Supported pin number and mux varies for different SoCs, and are
              defined as macros in dt-bindings/pinctrl/<soc>-pinfunc.h
              directly.

          drive-strength:
            enum: [2, 4, 6, 8, 10, 12, 14, 16]

          bias-pull-down:
            oneOf:
              - type: boolean
              - enum: [100, 101, 102, 103]
                description: Pull down PUPD/R0/R1 type define value.
            description: |
               For normal pull down type, it is not necessary to specify R1R0
               values. When pull down type is PUPD/R0/R1, adding R1R0 defines
               will set different resistance values.

          bias-pull-up:
            oneOf:
              - type: boolean
              - enum: [100, 101, 102, 103]
                description: Pull up PUPD/R0/R1 type define value.
            description: |
               For normal pull up type, it is not necessary to specify R1R0
               values. When pull up type is PUPD/R0/R1, adding R1R0 defines
               will set different resistance values.

          bias-disable: true

          output-high: true

          output-low: true

          input-enable: true

          input-disable: true

          input-schmitt-enable: true

          input-schmitt-disable: true

          mediatek,pull-up-adv:
            description: |
              Pull up setings for 2 pull resistors, R0 and R1. User can
              configure those special pins. Valid arguments are described as below:
              0: (R1, R0) = (0, 0) which means R1 disabled and R0 disabled.
              1: (R1, R0) = (0, 1) which means R1 disabled and R0 enabled.
              2: (R1, R0) = (1, 0) which means R1 enabled and R0 disabled.
              3: (R1, R0) = (1, 1) which means R1 enabled and R0 enabled.
            $ref: /schemas/types.yaml#/definitions/uint32
            enum: [0, 1, 2, 3]

          mediatek,pull-down-adv:
            description: |
              Pull down settings for 2 pull resistors, R0 and R1. User can
              configure those special pins. Valid arguments are described as below:
              0: (R1, R0) = (0, 0) which means R1 disabled and R0 disabled.
              1: (R1, R0) = (0, 1) which means R1 disabled and R0 enabled.
              2: (R1, R0) = (1, 0) which means R1 enabled and R0 disabled.
              3: (R1, R0) = (1, 1) which means R1 enabled and R0 enabled.
            $ref: /schemas/types.yaml#/definitions/uint32
            enum: [0, 1, 2, 3]

        required:
          - pinmux

additionalProperties: false

examples:
  - |
    #include <dt-bindings/interrupt-controller/arm-gic.h>
    #include <dt-bindings/interrupt-controller/irq.h>
    #include <dt-bindings/pinctrl/mt6795-pinfunc.h>

    soc {
        #address-cells = <2>;
        #size-cells = <2>;

        pio: pinctrl@10005000 {
            compatible = "mediatek,mt6795-pinctrl";
            reg = <0 0x10005000 0 0x1000>, <0 0x1000b000 0 0x1000>;
            reg-names = "base", "eint";
            gpio-controller;
            #gpio-cells = <2>;
            gpio-ranges = <&pio 0 0 196>;
            interrupt-controller;
            interrupts = <GIC_SPI 153 IRQ_TYPE_LEVEL_HIGH>;
            #interrupt-cells = <2>;

            i2c0-pins {
                pins-sda-scl {
                    pinmux = <PINMUX_GPIO45__FUNC_SDA0>,
                             <PINMUX_GPIO46__FUNC_SCL0>;
                };
            };

            mmc0-pins {
                pins-cmd-dat {
                    pinmux = <PINMUX_GPIO154__FUNC_MSDC0_DAT0>,
                             <PINMUX_GPIO155__FUNC_MSDC0_DAT1>,
                             <PINMUX_GPIO156__FUNC_MSDC0_DAT2>,
                             <PINMUX_GPIO157__FUNC_MSDC0_DAT3>,
                             <PINMUX_GPIO158__FUNC_MSDC0_DAT4>,
                             <PINMUX_GPIO159__FUNC_MSDC0_DAT5>,
                             <PINMUX_GPIO160__FUNC_MSDC0_DAT6>,
                             <PINMUX_GPIO161__FUNC_MSDC0_DAT7>,
                             <PINMUX_GPIO162__FUNC_MSDC0_CMD>;
                    input-enable;
                    bias-pull-up = <MTK_PUPD_SET_R1R0_01>;
                };

                pins-clk {
                    pinmux = <PINMUX_GPIO163__FUNC_MSDC0_CLK>;
                    bias-pull-down = <MTK_PUPD_SET_R1R0_10>;
                };

                pins-rst {
                    pinmux = <PINMUX_GPIO165__FUNC_MSDC0_RSTB>;
                    bias-pull-up = <MTK_PUPD_SET_R1R0_10>;
                };
            };
        };
    };
```

## Documentation/devicetree/bindings/soc/mediatek/mediatek,pwrap.yaml
```yaml
# SPDX-License-Identifier: (GPL-2.0-only OR BSD-2-Clause)
%YAML 1.2
---
$id: http://devicetree.org/schemas/soc/mediatek/mediatek,pwrap.yaml#
$schema: http://devicetree.org/meta-schemas/core.yaml#

title: MediaTek PMIC Wrapper

maintainers:
  - Flora Fu <flora.fu@mediatek.com>

description: |
  On MediaTek SoCs the PMIC is connected via SPI. The SPI master interface
  is not directly visible to the CPU, but only through the PMIC wrapper
  inside the SoC. The communication between the SoC and the PMIC can
  optionally be encrypted. Also a non standard Dual IO SPI mode can be
  used to increase speed.

  on MT8135 the pins of some SoC internal peripherals can be on the PMIC.
  The signals of these pins are routed over the SPI bus using the pwrap
  bridge.

properties:
  compatible:
    oneOf:
      - enum:
        - mediatek,mt2701-pwrap
        - mediatek,mt6765-pwrap
        - mediatek,mt6779-pwrap
        - mediatek,mt6797-pwrap
        - mediatek,mt6873-pwrap
        - mediatek,mt7622-pwrap
        - mediatek,mt8135-pwrap
        - mediatek,mt8173-pwrap
        - mediatek,mt8183-pwrap
        - mediatek,mt8186-pwrap
        - mediatek,mt8195-pwrap
        - mediatek,mt8516-pwrap
      - items:
        - const: mediatek,mt7623-pwrap
        - const: mediatek,mt2701-pwrap
      - items:
        - const: mediatek,mt8188-pwrap
        - const: mediatek,mt8195-pwrap

  reg:
    maxItems: 1

  reg-names:
    const: pwrap

  interrupts:
    maxItems: 1

  clocks:
    items:
      - description: SPI bus clock
      - description: Main module clock

  clock-names:
    items:
      - const: spi
      - const: wrap

  resets:
    maxItems: 1

  reset-names:
    const: pwrap

  pmic:
    type: object

    description: PMIC subnode

required:
  - compatible
  - reg
  - reg-names
  - interrupts
  - clocks
  - clock-names

allOf:
  - if:
      properties:
        compatible:
          contains:
            enum:
              - mediatek,mt2701-pwrap
              - mediatek,mt6765-pwrap
              - mediatek,mt6797-pwrap
              - mediatek,mt7622-pwrap
              - mediatek,mt8135-pwrap
              - mediatek,mt8173-pwrap
    then:
      required:
        - resets
        - reset-names
    else:
      properties:
        resets: false
        reset-names: false
  - if:
      properties:
        compatible:
          contains:
            const: mediatek,mt8135-pwrap
    then:
      properties:
        reg:
          minItems: 2
          maxItems: 2

        reg-names:
          items:
            - const: pwrap
            - const: pwrap-bridge

        resets:
          minItems: 2
          maxItems: 2

        reset-names:
          items:
            - const: pwrap
            - const: pwrap-bridge

additionalProperties: false

examples:
  - |
    #include <dt-bindings/interrupt-controller/arm-gic.h>
    #include <dt-bindings/interrupt-controller/irq.h>
    #include <dt-bindings/reset/mt8135-resets.h>

    pwrap: pwrap@1000f000 {
        compatible = "mediatek,mt8135-pwrap";
        reg = <0 0x1000f000 0 0x1000>,
              <0 0x11017000 0 0x1000>;
        reg-names = "pwrap", "pwrap-bridge";
        interrupts = <GIC_SPI 128 IRQ_TYPE_LEVEL_HIGH>;
        resets = <&infracfg MT8135_INFRA_PMIC_WRAP_RST>,
                 <&pericfg MT8135_PERI_PWRAP_BRIDGE_SW_RST>;
        reset-names = "pwrap", "pwrap-bridge";
        clocks = <&clk26m>, <&clk26m>;
        clock-names = "spi", "wrap";

        pmic {
            compatible = "mediatek,mt6397";
        };
    };
```
